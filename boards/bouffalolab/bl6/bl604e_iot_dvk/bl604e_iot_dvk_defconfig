## boards/bouffalolab/bl6/bl604e_iot_dvk/bl604e_iot_dvk_defconfig
```kconfig
# Copyright (c) 2022, ATL Electronics
# SPDX-License-Identifier: Apache-2.0

CONFIG_CONSOLE=y
CONFIG_SERIAL=y

CONFIG_UART_CONSOLE=y
CONFIG_UART_BFLB=y
CONFIG_BFLB_TO_ITCM=y
CONFIG_UART_INTERRUPT_DRIVEN=y
```

## boards/bouffalolab/bl61x/ai_m62_12f/Kconfig.ai_m62_12f
```kconfig
# Copyright (c) 2024 MASSDRIVER EI (massdriver.space)
# SPDX-License-Identifier: Apache-2.0

config BOARD_AI_M62_12F
	bool "BL616 WIFI+BT+Zigbee module"
	select SOC_BL616C50Q2I
```

## boards/riscv/xt_bl_zb1/Kconfig.board
```kconfig
# Bouffalo Lab BL602 DevKit
#
# Copyright (c) 2021 ATL Electronics
# SPDX-License-Identifier: Apache-2.0

config BOARD_XT_BL_ZB1
	bool "BL702 zigbee module"
	depends on SOC_PART_NUMBER_BL702C10Q2H
```

## boards/riscv/xt_bl_zb1/Kconfig.defconfig
```kconfig
# Bouffalo Lab BL702
#
# Copyright (c) 2024 MASDRIVER EI (massdriver.space)
# SPDX-License-Identifier: Apache-2.0

if BOARD_XT_BL_ZB1

config BOARD
	default "xt_bl_zb1"

endif   # BOARD_XT_BL_ZB1
```

## boards/riscv/xt_bl_zb1/xt_bl_zb1_defconfig
```kconfig
# Copyright (c) 2024, MASSDRIVER EI (massdriver.space)
# SPDX-License-Identifier: Apache-2.0

CONFIG_SOC_SERIES_BL7=y
CONFIG_SOC_PART_NUMBER_BL702C10Q2H=y
CONFIG_BOARD_XT_BL_ZB1=y

CONFIG_CONSOLE=y
CONFIG_UART_CONSOLE=y
CONFIG_SERIAL=y
CONFIG_UART_BFLB=y
```

## boards/tinyvision/pico_ice/Kconfig
```kconfig
# Copyright (c) 2025 tinyVision.ai
# SPDX-License-Identifier: Apache-2.0

config BOARD_PICO_ICE
	select RP2_FLASH_W25Q080
```

## boards/tinyvision/pico_ice/Kconfig.defconfig
```kconfig
# Copyright (c) 2025 tinyVision.ai
# SPDX-License-Identifier: Apache-2.0

if BOARD_PICO_ICE

if I2C_DW

config I2C_DW_CLOCK_SPEED
	default 125

endif # I2C_DW

config USB_SELF_POWERED
	default n

source "boards/common/usb/Kconfig.cdc_acm_serial.defconfig"

config USB_DEVICE_PRODUCT
	default "Zephyr RTOS on tinyVision.ai pico-ice"

config USB_DEVICE_VID
	default 0x1209

config USB_DEVICE_PID
	default 0xB1C0

endif # BOARD_PICO_ICE
```

## boards/tinyvision/pico_ice/Kconfig.pico_ice
```kconfig
# Copyright (c) 2025 tinyVision.ai
# SPDX-License-Identifier: Apache-2.0

config BOARD_PICO_ICE
	select SOC_RP2040
	select BOARD_REQUIRES_SERIAL_BACKEND_CDC_ACM
```

## boards/tinyvision/pico_ice/board.yml
```yaml
board:
  name: pico_ice
  full_name: tinyVision.ai pico-ice
  vendor: tinyvision
  socs:
  - name: rp2040
```

## drivers/dac/Kconfig.bflb
```kconfig
# Copyright (c) 2024 MASSDRIVER EI
# SPDX-License-Identifier: Apache-2.0

config DAC_BFLB
	bool "Bouffalolab DAC driver"
	default y
	depends on DT_HAS_BFLB_DAC_ENABLED
	help
	  Enable the Bouffalolab DAC driver.
```

## drivers/spi/Kconfig.bflb
```kconfig
# Copyright (c) 2024 MASSDRIVER EI (massdriver.space)
# SPDX-License-Identifier: Apache-2.0

config SPI_BFLB
	bool "Bouffalolab SPI driver"
	default y
	depends on DT_HAS_BFLB_BL_SPI_ENABLED
	help
	  Enable support for Bouffalolab SPI driver.
```

## drivers/wifi/bflb/Kconfig.bflb
```kconfig
# Copyright 2024 MASSDRIVER EI

config WIFI_BFLB
	bool "Bouffalolab SoC WiFi support"
	default n

menuconfig WIFI_BFLB_BL60X
	bool "Bouffalolab bl60x SoC WiFi support"
	default y
	depends on DT_HAS_BFLB_BL60X_WIFI_ENABLED
	select NET_L2_WIFI_MGMT
	select WIFI_USE_NATIVE_NETWORKING
	select WIFI_BFLB
	help
	  Enable Bouffalolab bl60x SoC WiFi support

if WIFI_BFLB_BL60X

config NET_TCP_WORKQ_STACK_SIZE
	default 2048

config NET_RX_STACK_SIZE
	default 2048

config NET_MGMT_EVENT_STACK_SIZE
	default 2048

endif # WIFI_BFLB_BL60X

menuconfig WIFI_BFLB_BL61X
	bool "Bouffalolab bl61x SoC WiFi support"
	default y
	depends on DT_HAS_BFLB_BL61X_WIFI_ENABLED
	select NET_L2_WIFI_MGMT
	select WIFI_USE_NATIVE_NETWORKING
	select WIFI_BFLB
	select THREAD_CUSTOM_DATA
	select DYNAMIC_THREAD
	select MBEDTLS
	help
	  Enable Bouffalolab bl61x SoC WiFi support

if WIFI_BFLB_BL61X

config NET_TCP_WORKQ_STACK_SIZE
	default 2048

config NET_RX_STACK_SIZE
	default 2048

config NET_MGMT_EVENT_STACK_SIZE
	default 2048

config WIFI_BFLB_BL61X_HEAP_SIZE
	hex "Size of the HAL heap for bl61x wifi"
	default 0x8000

config WIFI_BFLB_BL61X_STACK_SIZE
	hex "Size of the HAL stack for bl61x wifi"
	default 0x2000

endif # WIFI_BFLB_BL61X
```

## dts/bindings/adc/bflb,adc.yaml
```yaml
# Copyright (c) 2022 Wolter HV <wolterhv@gmx.de>
#
# SPDX-License-Identifier: Apache-2.0

description: |
  Bouffalolab ADC

compatible: "bflb,adc"

include: [adc-controller.yaml, pinctrl-device.yaml]

properties:
  reg:
    required: true

  interrupts:
    required: true

  "#io-channel-cells":
    const: 1

io-channel-cells:
  - input
```

## dts/bindings/bluetooth/bflb,bt-hci.yaml
```yaml
description: Bluetooth HCI for Bouffalolab SoC

compatible: "bflb,bt-hci"

include: bt-hci.yaml

properties:
  bt-hci-name:
    default: "BT BFLB"
  bt-hci-bus:
    default: "BT_HCI_BUS_IPM"
```

## dts/bindings/dac/bflb,dac.yaml
```yaml
# Copyright (c) 2022 Espressif Systems (Shanghai) Co., Ltd.
# SPDX-License-Identifier: Apache-2.0

description: |
    Two GPIO pads are capable of being DACs

    bl60x pads
      - GPIO13 as DAC channel 1
      - GPIO14 as DAC channel 2

    bl70x pads
      - GPIO11 as DAC channel 1
      - GPIO17 as DAC channel 2
    bl61x pads
      - GPIO3 as DAC channel 1
      - GPIO2 as DAC channel 2

compatible: "bflb,dac"

include: [dac-controller.yaml, pinctrl-device.yaml]

properties:

  "#io-channel-cells":
    const: 1


io-channel-cells:
  - output
```

## dts/bindings/gpio/bflb,bl61x-gpio.yaml
```yaml
# Copyright (c) 2021-2024, Gerson Fernando Budke <nandojve@gmail.com>
# SPDX-License-Identifier: Apache-2.0

description: Bouffalo Lab GPIO node for BL61X serie

compatible: "bflb,bl61x-gpio"

include:
  - name: base.yaml
  - name: gpio-controller.yaml

properties:
  reg:
    required: true

  interrupts:
    required: true

  "#gpio-cells":
    const: 2

gpio-cells:
  - pin
  - flags
```

## dts/bindings/interrupt-controller/sifive,clic.yaml
```yaml
# Copyright (c) 2024 MASSDRIVER EI (massdriver.space)
# SPDX-License-Identifier: Apache-2.0

description: SiFive CLIC interrupt controller

compatible: "sifive,clic"

include: [interrupt-controller.yaml, base.yaml]

properties:
  reg:
    required: true

  "#interrupt-cells":
    const: 2

interrupt-cells:
  - irq
  - priority
```

## dts/bindings/pinctrl/bflb,bl-pinctrl.yaml
```yaml
# Copyright (c) 2021, Gerson Fernando Budke <nandojve@gmail.com>
# SPDX-License-Identifier: Apache-2.0

description: |
      Bouffalo Lab pin controller pin configuration group. Each group contains
      a list of pins sharing the same set of properties. Example:
      uart0_default: uart0_default {
        /* group 1 (name is arbitrary) */
        pins1 {
          /* configure to uart0 function plus modem interrupt, pin 7 as UART_RX
             pin 16 as UART_TX and finally pin 18 as gpio */
          pinmux =  <BFLB_PIN(uart0,   7)>,
                    <BFLB_PIN(uart0,  16)>,
                    <BFLB_PIN(gpio,   18)>;
          bias-pull-up;
          input-schmitt-enable;
        };
      };
      The list of supported standard properties:
      - bias-high-impedance: Disable pull-up/down (default behavior, not
        required).
      - bias-pull-up: Enable pull-up resistor.
      - bias-pull-down: Enable pull-down resistor.
      - input-enable: Enable GPIO as input (default behavior, not required).
      - input-schmitt-enable: Enable Schimitt Trigger when GPIO is Input.
      - output-enable: Enable GPIO as output.

      Note that bias options are mutually exclusive. It is the same with GPIO
      input/output enable options.

compatible: "bflb,bl-pinctrl"

include:
  - name: base.yaml

child-binding:
  description: |
    Bouffalo pin controller pin configuration state nodes.
  child-binding:
    description:
      Bouffalo pin controller pin configuration group.

    include:
      - name: pincfg-node.yaml
        property-allowlist:
          - bias-high-impedance
          - bias-pull-down
          - bias-pull-up
          - input-enable
          - input-schmitt-enable
          - output-enable

    properties:
      pinmuxes:
        required: true
        type: array
        description: |
          An array of pins sharing the same group properties. The pins
          should be defined using the BFLB_PIN utility macro that encode
          function and pin.
      drive-strength:
        required: false
        type: int
        default: 0
        enum:
        - 0     # Default value, lower strength, 8mA
        - 1     # 9.6mA
        - 2     # 11.2mA
        - 3     # highest strength, 12.8mA
        description: |
          Pin drive strength. It tunes pin max current where 0 means lower
          value, which is the default, and 3 represents max drive strength.
```

## dts/bindings/serial/bflb,bl-uart.yaml
```yaml
# Copyright (c) 2021, ATL Electronics
# SPDX-License-Identifier: Apache-2.0

description: Bouffalo Lab UART

compatible: "bflb,bl-uart"

include: [uart-controller.yaml, pinctrl-device.yaml]

properties:
    reg:
      required: true
    tx-pin:
      required: true
      type: int
      default: 16
    rx-pin:
      required: true
      type: int
      default: 7
```

## dts/bindings/spi/bflb,bl-spi.yaml
```yaml
# Copyright (c) 2024 MASSDRIVER EI (massdriver.space)
# SPDX-License-Identifier: Apache-2.0

description: Bouffalolab SPI

compatible: "bflb,bl-spi"

include:
  - name: spi-controller.yaml
  - name: pinctrl-device.yaml

properties:
  reg:
    required: true

  interrupts:
    required: true
```

## dts/bindings/timer/riscv,mtime-timer.yaml
```yaml
# Copyright (c) 2024 MASSDRIVER EI (massdriver.space)
# SPDX-License-Identifier: Apache-2.0

description: RISC-V Standard mtime Timer.

compatible: "riscv,mtime-timer"

include: base.yaml

properties:
  reg:
    required: true
  interrupts-extended:
    required: true
```
