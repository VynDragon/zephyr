## boards/bflb/bl70xl/bl702l_dvk/Kconfig.bl702l_dvk
```kconfig
# Copyright The Zephyr Project Contributors
# SPDX-License-Identifier: Apache-2.0

config BOARD_BL702L_DVK
	select SOC_BL70XL
```

## boards/bflb/bl70xl/bl702l_dvk/Kconfig.defconfig
```kconfig
# Copyright The Zephyr Project Contributors
# SPDX-License-Identifier: Apache-2.0

if BOARD_BL702L_DVK

config BOARD
	default "bl702l_dvk"

endif # BOARD_BL702L_DVK
```

## boards/bflb/bl70xl/bl702l_dvk/board.yml
```yaml
# Copyright The Zephyr Project Contributors
# SPDX-License-Identifier: Apache-2.0

board:
  name: bl702l_dvk
  full_name: Bouffalo Labs BL70XL Development Kit
  vendor: bflb
  socs:
    - name: bl704l22q2h
```

## boards/bouffalolab/bl70xl/3r_zigbee_sensor/Kconfig.3r_zigbee_sensor
```kconfig
# Bouffalolab BL702
# Copyright (c) 2024 MASSDRIVER EI (massdriver.space)
# SPDX-License-Identifier: Apache-2.0

config BOARD_3R_ZIGBEE_SENSOR
	bool "BL702 zigbee module"
	select SOC_BL704L10Q2I
```

## boards/ebyte/e290_400mbl_sc/Kconfig.defconfig
```kconfig
# SPDX-FileCopyrightText: Copyright The Zephyr Project Contributors
# SPDX-License-Identifier: Apache-2.0

if BOARD_E290_400MBL_SC

if LORA

choice LORA_MODULE_BACKEND
	default LORA_MODULE_BACKEND_NATIVE
endchoice

endif # LORA

config USB_SELF_POWERED
	default n

source "boards/common/usb/Kconfig.cdc_acm_serial.defconfig"

# We are starved for space, save space

if LOG

choice LOG_MODE
	default LOG_MODE_MINIMAL
endchoice

endif # LOG

if I2C

config I2C_STM32_INTERRUPT
	default n

endif # I2C

if UDC_DRIVER

config UDC_DRIVER_HIGH_SPEED_SUPPORT_ENABLED
	default n

choice USBD_MAX_SPEED_CHOICE
	default USBD_MAX_SPEED_FULL
endchoice

if USBD_CDC_ACM_CLASS

config USBD_CDC_ACM_STACK_SIZE
	default 512

config USBD_CDC_ACM_BUF_POOL_SIZE
	default 64
	# Wrong range in class Kconfig
	range 64 $(UINT16_MAX)

endif # USBD_CDC_ACM_CLASS

endif # UDC_DRIVER

endif # BOARD_E290_400MBL_SC
```

## boards/ebyte/e290_400mbl_sc/Kconfig.e290_400mbl_sc
```kconfig
# Copyright (c) 2026 MASSDRIVER EI (massdriver.space)
# SPDX-License-Identifier: Apache-2.0

config BOARD_E290_400MBL_SC
	select SOC_STM32F103X8
```

## boards/ebyte/e290_400mbl_sc/board.yml
```yaml
board:
  name: e290_400mbl_sc
  full_name: Ebyte E290 Module Development Board (PAN3029)
  vendor: ebyte
  socs:
    - name: stm32f103xb
```

## boards/tinyvision/pico2_ice/Kconfig.defconfig
```kconfig
# Copyright (c) 2025 tinyVision.ai
# SPDX-License-Identifier: Apache-2.0

if BOARD_PICO2_ICE

source "boards/common/usb/Kconfig.cdc_acm_serial.defconfig"

config USB_SELF_POWERED
	default n

endif # BOARD_PICO2_ICE
```

## boards/tinyvision/pico2_ice/Kconfig.pico2_ice
```kconfig
# Copyright (c) 2025 tinyVision.ai
# SPDX-License-Identifier: Apache-2.0

config BOARD_PICO2_ICE
	select SOC_RP2350B_M33 if BOARD_PICO2_ICE_RP2350B_M33
```

## boards/tinyvision/pico2_ice/board.yml
```yaml
board:
  name: pico2_ice
  full_name: tinyVision.ai pico2-ice
  vendor: tinyvision
  socs:
  - name: rp2350b
```

## drivers/clock_control/Kconfig.bflb_bl61x
```kconfig
# Copyright (c) 2025 MASSDRIVER EI (massdriver.space)
# SPDX-License-Identifier: Apache-2.0

config CLOCK_CONTROL_BOUFFALOLAB_BL61x
	bool "Bouffalolab BL61x Clock Control Driver"
	default y
	depends on DT_HAS_BFLB_BL61X_CLOCK_CONTROLLER_ENABLED
```

## drivers/eeprom/Kconfig.bflb
```kconfig
# Copyright (c) 2024-2025 MASSDRIVER EI (massdriver.space)
# SPDX-License-Identifier: Apache-2.0

config EFUSE_BFLB
	bool "Bouffalolab EFUSEs driver"
	default y
	depends on DT_HAS_BFLB_EFUSE_ENABLED
	help
	  Enable accessing internal Efuses via EEPROM API for Bouffalolab platforms.
```

## drivers/lora/native/pan30xx/Kconfig
```kconfig
# Copyright (c) 2026 MASSDRIVER EI (massdriver.space)
# SPDX-License-Identifier: Apache-2.0

config LORA_PAN30XX_NATIVE
	bool "Panchip PAN30xx native driver (experimental)"
	default y
	depends on LORA_MODULE_BACKEND_NATIVE
	depends on DT_HAS_PANCHIP_PAN3029_ENABLED || DT_HAS_PANCHIP_PAN3060_ENABLED
	select SPI if $(dt_compat_on_bus,$(DT_COMPAT_PANCHIP_PAN3029),spi)
	select I2C if $(dt_compat_on_bus,$(DT_COMPAT_PANCHIP_PAN3029),i2c)
	select SPI if $(dt_compat_on_bus,$(DT_COMPAT_PANCHIP_PAN3060),spi)
	select I2C if $(dt_compat_on_bus,$(DT_COMPAT_PANCHIP_PAN3060),i2c)
	select GPIO
	help
	  Enable native driver for Panchip PAN30xx ChirpIoT transceivers.
	  This is an experimental driver that does not depend on loramac-node
	  or lora-basics-modem external modules.

config LORA_PAN30XX_NATIVE_SLEEP
	bool "Sleep mode power management"
	default y
	depends on LORA_PAN30XX_NATIVE
	help
	  Place the PAN30xx radio into sleep mode when idle to reduce
	  power consumption (~620 nA vs an unspecified amount in standby).
	  Disable to keep the radio in standby for faster response times.
```

## drivers/sdhc/Kconfig.bflb
```kconfig
# Copyright The Zephyr Project Contributors
# SPDX-License-Identifier: Apache-2.0

config SDHC_BFLB
	bool "Bouffalo Lab SDHC driver"
	default y
	depends on DT_HAS_BFLB_SDHC_ENABLED
	select SDHC_SUPPORTS_NATIVE_MODE
	select PINCTRL
	help
	  Enable the Bouffalo Lab SD Host Controller driver.
	  This is a polling-based PIO driver for initial bring-up.
```

## drivers/usb/udc/Kconfig.bflb
```kconfig
# Copyright (c) 2024-2026 MASSDRIVER EI (massdriver.space)
# Copyright The Zephyr Project Contributors
# SPDX-License-Identifier: Apache-2.0

config UDC_BFLB_V2
	bool "Bouffalo Lab USB V2 device controller driver"
	default y
	depends on DT_HAS_BFLB_UDC_2_ENABLED
	select UDC_DRIVER_HAS_HIGH_SPEED_SUPPORT
	imply UDC_WORKQUEUE
	help
	  USB 2.0 device controller driver for Bouffalo Lab SoCs
	  with the USB V2 peripheral.
	  Supports high-speed operation and exposes EP0 plus
	  four shared DMA-backed data endpoints.

if UDC_BFLB_V2

choice UDC_BFLB_V2_FIFO_SETUP
	bool "How many FIFOs are used per endpoint"
	default UDC_BFLB_V2_FIFO_BIDIR

config UDC_BFLB_V2_FIFO_MONODIR
	bool "Use a FIFO per endpoint direction"
	help
	  Use one FIFO per endpoint direction: Limits usable endpoints to two.

config UDC_BFLB_V2_FIFO_BIDIR
	bool "Use a FIFO for both endpoint directions"
	help
	  Use a single FIFO for both endpoint direction.

endchoice

config UDC_BFLB_V2_EVENT_COUNT
	int "Number or blocks in event slab"
	range 8 32
	default 16
	help
	  Number of blocks in slab for internal endpoint events.

endif # UDC_BFLB_V2
```

## dts/bindings/clock/bflb,bl61x-root-clk.yaml
```yaml
# Copyright (c) 2025 MASSDRIVER EI (massdriver.space)
# SPDX-License-Identifier: Apache-2.0

description: |
  The BL61x Root Clock
  Represents both FCLK and HCLK, which should be kept the same.
  Source -> FCLK / divider -> HCLK / divider -> BCLK

compatible: "bflb,bl61x-root-clk"

include: [base.yaml, clock-controller.yaml]

properties:
  clocks:
    type: phandle-array
    required: true
    description: source

  pll-select:
    type: int
    required: true
    enum:
      - 1
      - 2
    description: |
      Select PLL divider ID when relevant
      For wifi PLL, 1 is 320M and 2 is 240M

  divider:
    type: int
    required: true
    description: Divide source clock by this 8-bits value (FCLK divider). Typically 1.
```

## dts/bindings/clock/bflb,bl61x-wifipll.yaml
```yaml
# Copyright (c) 2025 MASSDRIVER EI (massdriver.space)
# SPDX-License-Identifier: Apache-2.0

description: The BL61x WIFI PLL

compatible: "bflb,bl61x-wifipll"

include: [base.yaml, clock-controller.yaml]

properties:
  clocks:
    type: phandle-array
    required: true
    description: source

  overclock:
    type: boolean
    description: |
      Overclock PLL to 480MHz for div ID 1 and 360MHz for div ID 2
      BCLK divider MUST be set so BCLK is 80MHz or slower
      Breaks most complex peripherals (USB, Wifi)

  "#clock-cells":
    const: 0
```

## dts/bindings/clock/bflb,bl70x-root-clk.yaml
```yaml
# Copyright (c) 2025 MASSDRIVER EI (massdriver.space)
# SPDX-License-Identifier: Apache-2.0

description: |
  The BL70x Root Clock

compatible: "bflb,bl70x-root-clk"

include: [base.yaml, clock-controller.yaml]

properties:
  clocks:
    type: phandle-array
    required: true
    description: source

  dll-select:
    type: int
    required: true
    enum:
      - 0
      - 1
      - 2
    description: |
      Select DLL divider ID
      0 = 57.6M, 1 = 96M, 2 = 144M

  divider:
    type: int
    required: true
    description: Divide source clock by this 8-bits value. Typically 1.
```

## dts/bindings/clock/bflb,bl70xl-clock-controller.yaml
```yaml
# Copyright The Zephyr Project Contributors
# SPDX-License-Identifier: Apache-2.0

description: Bouffalolab BL70XL Clock Controller

compatible: "bflb,bl70xl-clock-controller"

include: [base.yaml, clock-controller.yaml]

properties:
  "#clock-cells":
    const: 1

clock-cells:
  - id
```

## dts/bindings/clock/bflb,bl70xl-root-clk.yaml
```yaml
# Copyright (c) 2025 MASSDRIVER EI (massdriver.space)
# SPDX-License-Identifier: Apache-2.0

description: |
  The BL70xl Root Clock

compatible: "bflb,bl70xl-root-clk"

include: [base.yaml, clock-controller.yaml]

properties:
  clocks:
    type: phandle-array
    required: true
    description: source

  divider:
    type: int
    required: true
    description: Divide source clock by this 8-bits value. Typically 1.

  "#clock-cells":
    const: 0
```

## dts/bindings/lora/panchip,pan3029-spi.yaml
```yaml
# Copyright (c) 2026 MASSDRIVER EI (massdriver.space)
# SPDX-License-Identifier: Apache-2.0

title: Panchip PAN3029 ChirpIoT Modem on SPI bus

description: |
  Panchip PAN3029 ChirpIoT Modem. It supports up to 20dBm of transmit power over the
  137-1110MHz sub-GHz ISM bands, sensitivity as low as -143dBm, spreading factors 5 to 12,
  and bandwidths of 62.5KHz, 125KHz, 250KHz, and 500KHz.
  It has limited compatibility with LoRa modulation.

compatible: "panchip,pan3029"

include: ["panchip,pan30xx-base.yaml", "spi-device.yaml"]
```

## dts/bindings/lora/panchip,pan3060-i2c.yaml
```yaml
# Copyright (c) 2026 MASSDRIVER EI (massdriver.space)
# SPDX-License-Identifier: Apache-2.0

title: Panchip PAN3060 ChirpIoT Modem on I2C bus

description: |
  Panchip PAN3060 ChirpIoT Modem. It supports up to 20dBm of transmit power over the
  137-1110MHz sub-GHz ISM bands, sensitivity as low as -130dBm, spreading factors 5 to 9,
  and bandwidths of 125KHz, 250KHz, and 500KHz.
  It has limited compatibility with LoRa modulation.

compatible: "panchip,pan3060"

include: ["panchip,pan30xx-base.yaml", "i2c-device.yaml"]
```

## dts/bindings/lora/panchip,pan30xx-base.yaml
```yaml
# Copyright (c) 2026 MASSDRIVER EI (massdriver.space)
# SPDX-License-Identifier: Apache-2.0

properties:
  irq-gpios:
    type: phandle-array
    required: true
    description: |
      Pin connected to the modem's typically active-high IRQ Pin.

  reset-gpios:
    type: phandle-array
    description: |
      Optional pin connected to the modem's typically active-low RESET signal.

  gpio10-is-txen:
    type: boolean
    description: |
      Configure modem's GPIO10 pin to output the transmission status:
      Low for Receiving or inactive, High for Transmitting.

  gpio11-is-cad:
    type: boolean
    description: |
      Configure modem's GPIO11 pin to inform the host of an ongoing preamble transmission
      with the same bandwidth and spreading factor settings when in RX mode.
      High when currently detecting a signal, Low otherwise.

  tcxo-power-startup-delay-ms:
    type: int
    default: 30
    description: |
      Startup delay to let the TCXO stabilize after TCXO power on. 30 ms is usually sufficient.

  gpios-enable:
    type: int
    default: 0
    description: |
      Use bitmasked GPIOs as outputs. Pins set here are used to set the RF path,
      power the TCXO and drive other functions the user may need in the provided states.
      Unset pins are kept Hi-Z.
      - A[0]: GPIO0 (TX_EN in switched reference design)
      - A[1]: GPIO3
      - A[2]: GPIO10 (RX_EN in switched reference design)
      - A[3]: GPIO11

      The default has no GPIOs active.
      GPIO10 cannot be used simultaneously with gpio10-is-txen.
      GPIO11 cannot be used simultaneously with gpio11-is-cad.
      To use a GPIO to power a TCXO, set the GPIO bit corresponding to it in all modes.
      The GPIOs enabled here are directly controlled by the host and not automated by the modem.

  gpios-standby:
    type: int
    default: 0
    description: |
      GPIOs state in standby mode. See gpios-enable for mask bit meaning.
      Defines which GPIOs are set high (bit set) or low (bit unset) in standby mode.

  gpios-rx:
    type: int
    default: 0
    description: GPIOs state in RX mode. See gpios-standby.

  gpios-tx:
    type: int
    default: 0
    description: GPIOs state in TX mode. See gpios-standby.

  use-dcdc:
    type: boolean
    description: Use DCDC regulator instead of LDO.

  force-ldro:
    type: boolean
    description: |
      Force usage of Low Data Rate Optimization even in cases where the symbol time is shorter than
      16.38ms. Useful for designs using no TCXO or with bad heat dissipation.

  lora-modulation:
    type: boolean
    description: |
      Use LoRa modulation instead of ChirpIoT modulation.
```

## dts/bindings/memory-controllers/bflb,sf-controller.yaml
```yaml
# Copyright (c) 2026 MASSDRIVER EI
# SPDX-License-Identifier: Apache-2.0

title: Bouffalolab Serial Flash controller

description: |
  The Bouffalolab Serial Flash controller controls two banks of SPI devices.
  The second bank can be writable.
  Using banks other than the embedded flash require pinctrl settings.

compatible: "bflb,sf-controller"

include: [base.yaml, pinctrl-device.yaml]

properties:
  reg:
    required: true

  override-bank1:
    type: boolean
    description: |
      Force using DTS provided settings instead of the flash header's for bank1's settings.
```
