## dts/bindings/usb/bflb,udc-bl61x.yaml
```yaml
# Copyright (c) 2024 MASSDRIVER EI (massdriver.space)
# SPDX-License-Identifier: Apache-2.0

description: BFLB BL61x USB device controller

compatible: "bflb,udc-bl61x"

include: usb-ep.yaml

properties:
  reg:
    required: true

  interrupts:
    required: true
```

## dts/bindings/wifi/bflb,wifi.yaml
```yaml
# Copyright (c) 2024 MASSDRIVER EI
# SPDX-License-Identifier: Apache-2.0

description: Bouffalolab SoC WiFi

compatible: "bflb,wifi"
```

## soc/bouffalolab/bflb/bl6/Kconfig.defconfig
```kconfig
# Copyright (c) 2021, ATL Electronics
# SPDX-License-Identifier: Apache-2.0

if SOC_SERIES_BL6

config SYS_CLOCK_HW_CYCLES_PER_SEC
	default 160000000

config NUM_IRQS
	default 80

config ARCH_SW_ISR_TABLE_ALIGN
	default 64

config RISCV_MCAUSE_EXCEPTION_MASK
	default 0x3FF

endif   # SOC_SERIES_BL6
```

## soc/bouffalolab/bflb/bl61x/Kconfig
```kconfig
# Copyright (c) 2024 MASSDRIVER EI (massdriver.space)
# SPDX-License-Identifier: Apache-2.0

config SOC_SERIES_BL61X
	select RISCV
	select RISCV_MACHINE_TIMER
	select ATOMIC_OPERATIONS_C
	select CPU_HAS_FPU
	select FPU
	select FLOAT_HARD
	select INCLUDE_RESET_VECTOR
	select XIP
	select RISCV_PRIVILEGED
	select RISCV_HAS_CLIC
	select RISCV_VECTORED_MODE
	select GEN_IRQ_VECTOR_TABLE

	select RISCV_ISA_RV32I
	select RISCV_ISA_EXT_M
	select RISCV_ISA_EXT_A
	select RISCV_ISA_EXT_F
	select RISCV_ISA_EXT_C
	select RISCV_ISA_EXT_P
	select RISCV_ISA_EXT_ZICSR
	select RISCV_ISA_EXT_ZIFENCEI

#	select RISCV_ISA_EXT_XTHEADBA
#	select RISCV_ISA_EXT_XTHEADBB
#	select RISCV_ISA_EXT_XTHEADBS
#	select RISCV_ISA_EXT_XTHEADCMO
#	select RISCV_ISA_EXT_XTHEADCONDMOV
#	select RISCV_ISA_EXT_XTHEADINT
#	select RISCV_ISA_EXT_XTHEADMAC
#	select RISCV_ISA_EXT_XTHEADMEMIDX
#	select RISCV_ISA_EXT_XTHEADSYNC

	# other extensions: zpsfoperand

	select CODE_DATA_RELOCATION
```

## soc/bouffalolab/bflb/bl7/Kconfig.soc
```kconfig
# Copyright (c) 2024 MASSDRIVER EI (massdriver.space)
# SPDX-License-Identifier: Apache-2.0

config SOC_SERIES_BL7
	bool
	select SOC_FAMILY_BFLB
	help
	  Enable support for BouffaloLab BL6xx MCU series

config SOC_SERIES
	default "bl7" if SOC_SERIES_BL7

config SOC_BL702SA0Q2I
	bool
	select SOC_SERIES_BL7

config SOC_BL702S10Q2I
	bool
	select SOC_SERIES_BL7

config SOC_BL702C10Q2H
	bool
	select SOC_SERIES_BL7

config SOC_BL706C10Q2I
	bool
	select SOC_SERIES_BL7

config SOC_BL706S10Q2I
	bool
	select SOC_SERIES_BL7

config SOC_BL706C22Q2I
	bool
	select SOC_SERIES_BL7

config SOC
	default "bl702sa0q2i" if SOC_BL702SA0Q2I
	default "bl702s10q2i" if SOC_BL702S10Q2I
	default "bl702c10q2h" if SOC_BL702C10Q2H
	default "bl706c10q2i" if SOC_BL706C10Q2I
	default "bl706s10q2i" if SOC_BL706S10Q2I
	default "bl706c22q2i" if SOC_BL706C22Q2I
```

## soc/riscv/bouffalolab/bflb/Kconfig.defconfig.bl7
```kconfig
# Copyright (c) 2024, MASSDRIVER EI (massdriver.space)
# SPDX-License-Identifier: Apache-2.0

if SOC_SERIES_BL7

config SOC_SERIES
	default "bflb"

config SOC_SUB_SERIES
	string
	default "bl702"

config SOC_PART_NUMBER
	string
	default "bl702sa0q2i" if SOC_PART_NUMBER_BL702SA0Q2I
	default "bl702s10q2i" if SOC_PART_NUMBER_BL702S10Q2I
	default "bl702c10q2h" if SOC_PART_NUMBER_BL702C10Q2H
	default "bl706c10q2i" if SOC_PART_NUMBER_BL706C10Q2I
	default "bl706s10q2i" if SOC_PART_NUMBER_BL706S10Q2I
	default "bl706c22q2i" if SOC_PART_NUMBER_BL706C22Q2I

config SYS_CLOCK_HW_CYCLES_PER_SEC
	default 144000000

config NUM_IRQS
	default 64

endif   # SOC_SERIES_BL6
```

## soc/riscv/bouffalolab/bflb/Kconfig.series
```kconfig
# Copyright (c) 2021, ATL Electronics
# SPDX-License-Identifier: Apache-2.0

config SOC_SERIES_BL6
	bool "Bouffalo Lab BL6 series MCU"
	select RISCV
#	select RISCV_GP
	select RISCV_HAS_CPU_IDLE
	select RISCV_MACHINE_TIMER
	select ATOMIC_OPERATIONS_C
	select COMPRESSED_ISA
	select SOC_FAMILY_BFLB
	select CPU_HAS_FPU
	select INCLUDE_RESET_VECTOR
	select XIP
	select RISCV_PRIVILEGED
#	select RISCV_HAS_CLIC
#	select RISCV_VECTORED_MODE
#	select RISCV_SOC_INTERRUPT_INIT
	help
	  Enable support for Bouffalo Lab BL6 MCU series

config SOC_SERIES_BL7
	bool "Bouffalo Lab BL6 series MCU"
	select RISCV
#	select RISCV_GP
	select RISCV_HAS_CPU_IDLE
	select RISCV_MACHINE_TIMER
	select ATOMIC_OPERATIONS_C
	select COMPRESSED_ISA
	select SOC_FAMILY_BFLB
	select CPU_HAS_FPU
	select INCLUDE_RESET_VECTOR
	select XIP
	select RISCV_PRIVILEGED
#	select RISCV_HAS_CLIC
#	select RISCV_VECTORED_MODE
#	select RISCV_SOC_INTERRUPT_INIT
	help
	  Enable support for Bouffalo Lab BL7 MCU series
```

## soc/riscv/bouffalolab/bflb/Kconfig.soc.bl7
```kconfig
# Copyright (c) 2024, MASSDRIVER EI (massdriver.space)
# SPDX-License-Identifier: Apache-2.0

choice
	prompt "bouffalo Lab BL7 MCU Selection"
	depends on SOC_SERIES_BL7

	config SOC_PART_NUMBER_BL702SA0Q2I
		bool "BL702SA0Q2I"
		select RISCV_ISA_RV32I
		select RISCV_ISA_EXT_M
		select RISCV_ISA_EXT_A
		select RISCV_ISA_EXT_C
		select RISCV_ISA_EXT_ZICSR
		select RISCV_ISA_EXT_ZIFENCEI

	config SOC_PART_NUMBER_BL702S10Q2I
		bool "BL702S10Q2I"
		select RISCV_ISA_RV32I
		select RISCV_ISA_EXT_M
		select RISCV_ISA_EXT_A
		select RISCV_ISA_EXT_C
		select RISCV_ISA_EXT_ZICSR
		select RISCV_ISA_EXT_ZIFENCEI

	config SOC_PART_NUMBER_BL702C10Q2H
		bool "BL702C10Q2H"
		select RISCV_ISA_RV32I
		select RISCV_ISA_EXT_M
		select RISCV_ISA_EXT_A
		select RISCV_ISA_EXT_C
		select RISCV_ISA_EXT_ZICSR
		select RISCV_ISA_EXT_ZIFENCEI

	config SOC_PART_NUMBER_BL706C10Q2I
		bool "BL706C10Q2I"
		select RISCV_ISA_RV32I
		select RISCV_ISA_EXT_M
		select RISCV_ISA_EXT_A
		select RISCV_ISA_EXT_C
		select RISCV_ISA_EXT_ZICSR
		select RISCV_ISA_EXT_ZIFENCEI

	config SOC_PART_NUMBER_BL706S10Q2I
		bool "BL706S10Q2I"
		select RISCV_ISA_RV32I
		select RISCV_ISA_EXT_M
		select RISCV_ISA_EXT_A
		select RISCV_ISA_EXT_C
		select RISCV_ISA_EXT_ZICSR
		select RISCV_ISA_EXT_ZIFENCEI

	config SOC_PART_NUMBER_BL706C22Q2I
		bool "BL706C22Q2I"
		select RISCV_ISA_RV32I
		select RISCV_ISA_EXT_M
		select RISCV_ISA_EXT_A
		select RISCV_ISA_EXT_C
		select RISCV_ISA_EXT_ZICSR
		select RISCV_ISA_EXT_ZIFENCEI

endchoice
```
