## dts/bindings/mtd/bflb,sf-device.yaml
```yaml
# Copyright (c) 2026 MASSDRIVER EI
# SPDX-License-Identifier: Apache-2.0

title: Bouffalolab Serial Flash controller device

description: |
  Bouffalolab Serial Flash controller device
  QPI (Quad I/O for everything) mode is unsupported by the driver
  Continuous read support is experimental.

compatible: "bflb,sf-device"

include: pinctrl-device.yaml

properties:
  reg:
    required: true

  sf-pad:
    type: int
    required: true
    description: |
      Which pad is this device holding. This is directly related to which pins are used.
      Pad 1 is usually the embedded flash, Pad 2 and Pad 3 are usually external.
      Main exception is BL70x where the default embedded pad is SF2.
    enum:
      - 1
      - 2
      - 3

  spi-bus-mode:
    type: int
    required: true
    description: |
     The width and mode of SPI bus to which the device is connected.
     Numbers refer to the number of line used in each direction.

     Possible values are:
      - IO <0> = 1 In (to the device), 1 Out (from the device)
      - DO <1> = 1 In, 2 Out
      - QO <2> = 1 In, 4 Out
      - DIO <3> = 2 In, 2 Out
      - QIO <4> = 4 In, 4 Out
    enum:
      - 0
      - 1
      - 2
      - 3
      - 4

  read-command:
    type: int
    description: |
      SPI command to use for memory-mapped reading.

  read-dummy-cycles:
    type: int
    description: |
      Dummy cycles for automatic read mode. They are expressed in bytes (8 cycles).

  continuous-read-command:
    type: int
    description: |
      Enable continuous read using this command setting.

  write-command:
    type: int
    description: |
      SPI command to use for memory-mapped writing. Device must not require explicit or page sized
      erase.

  write-dummy-cycles:
    type: int
    description: |
      Dummy cycles for automatic write mode. They are expressed in bytes (8 cycles).

  initialization-sequence:
    type: array
    description: |
      Triples of command, data, datalength writes to set things up at setup time. For example to clear
      out block protection, or setup dummy timing. up to 4 bytes of data can be sent at once.
      Remember the byte order is inverted (right to left)
```

## dts/bindings/mtd/bflb,sf-flash.yaml
```yaml
# Copyright (c) 2026 MASSDRIVER EI
# SPDX-License-Identifier: Apache-2.0

title: Bouffalolab Serial Flash controller Flash

description: Bouffalolab Serial Flash controller Flash or device compatible with JESD216

compatible: "bflb,sf-flash"

include:
  - soc-nv-flash.yaml
  - "bflb,sf-device.yaml"
  - "jedec,spi-nor-common.yaml"

examples:
  - |
    // mx25l51245g in DIO mode.
    flash1: flash@A4000000 {
      compatible = "bflb,sf-flash", "mxic,mx25l51245g";
      // We cannot use 4 bytes addresses without the main flash also supporting it
      reg = <0xA4000000 0x1000000>;
      ranges = <0x0 0xA4000000 0x1000000>;
      #address-cells = <1>;
      #size-cells = <1>;
      write-block-size = <256>;
      erase-block-size = <DT_SIZE_K(4)>;
      spi-bus-mode = <3>;
      sf-pad = <2>;
      jedec-id = [c2 20 1a];
      pinctrl-0 = <&sf2_default>;
      pinctrl-names = "default";
      use-sfdp;
      initialization-sequence = <0x06 0x0 0x0 0x1 0x0002 0x2>;

      partitions {
        compatible = "soc-nv-flash";
        ranges;
        #address-cells = <1>;
        #size-cells = <1>;

        storage_partition2: partition2@0 {
          compatible = "zephyr,mapped-partition";
          label = "storage_2";
          reg = <0x0 0x1000000>;
        };
      };
    };

properties:
  use-sfdp:
    type: boolean
    description: |
      Fetch commands from flash using SFDP instead of using defaults (Recommended).
      In the case of setting both 'override-bank1' and this, bank1 will use the sdfp command
      matching the spi-bus-mode selected, or override with dts command if it is set.
```

## dts/bindings/usb/bflb,udc-2.yaml
```yaml
# Copyright (c) 2024-2026 MASSDRIVER EI (massdriver.space)
# SPDX-License-Identifier: Apache-2.0

description: Bouffalo Lab USB 2.0 High-Speed device controller (v2 block)

compatible: "bflb,udc-2"

include: [usb-controller.yaml]

properties:
  reg:
    required: true

  interrupts:
    required: true
```

## soc/bflb/Kconfig.defconfig
```kconfig
# Copyright (c) 2021-2025 ATL Electronics
#
# SPDX-License-Identifier: Apache-2.0

if SOC_FAMILY_BFLB

config MAIN_STACK_SIZE
	default 4096

DT_CHOSEN_BFLB_HEAP_RAM := bflb,heap-ram
DT_CHOSEN_BFLB_HEAP_PSRAM := bflb,heap-psram

configdefault MBEDTLS_HEAP_CUSTOM_SECTION
	default y if $(dt_chosen_enabled,$(DT_CHOSEN_BFLB_HEAP_RAM))
	default y if $(dt_chosen_enabled,$(DT_CHOSEN_BFLB_HEAP_PSRAM)) && MEMC

rsource "*/Kconfig.defconfig"

endif # SOC_FAMILY_BFLB
```

## soc/bflb/bl616cl/Kconfig.soc
```kconfig
# Copyright (c) 2026 MASSDRIVER EI (massdriver.space)
#
# SPDX-License-Identifier: Apache-2.0

config SOC_SERIES_BL616CL
	bool
	select SOC_FAMILY_BFLB
	help
	  Enable support for BouffaloLab BL616CL MCU series

config SOC_SERIES
	default "bl616cl" if SOC_SERIES_BL616CL

config SOC_BL616CL4855
	bool
	select SOC_SERIES_BL616CL

config SOC
	default "bl616cl4855" if SOC_BL616CL4855
```

## soc/bflb/bl70xl/Kconfig.soc
```kconfig
# Copyright The Zephyr Project Contributors
#
# SPDX-License-Identifier: Apache-2.0

config SOC_SERIES_BL70XL
	bool
	select SOC_FAMILY_BFLB
	help
	  Enable support for BouffaloLab BL70XL MCU series

config SOC_SERIES
	default "bl70xl" if SOC_SERIES_BL70XL

config SOC_BL70XL
	bool
	select SOC_SERIES_BL70XL

config SOC
	default "bl70xl" if SOC_BL70XL
```

## soc/bouffalolab/bflb/Kconfig
```kconfig
# Copyright (c) 2021, ATL Electronics
# SPDX-License-Identifier: Apache-2.0

if SOC_FAMILY_BFLB

rsource "*/Kconfig"

config SYSCON
	default y

endif # SOC_FAMILY_BFLB
```
