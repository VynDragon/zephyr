/*
 * Copyright (c) 2021 ATL Electronics
 *
 * SPDX-License-Identifier: Apache-2.0
 */

#include <bouffalolab/bl7.dtsi>

/ {
	soc {
		sram0: memory@42018000 {
			reg = <0x42018000 DT_SIZE_K(96)>;
		};
	};
};
